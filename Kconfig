## Kconfig
```kconfig
DT_COMPAT_ZMK_LAYER_COLOR := zmk,layer-color

config ZMK_LAYER_COLOR
    bool "Colour the RGB underglow by active layer"
    default $(dt_compat_enabled,$(DT_COMPAT_ZMK_LAYER_COLOR))
    depends on ZMK_RGB_UNDERGLOW
    depends on !ZMK_SPLIT || ZMK_SPLIT_ROLE_CENTRAL

if ZMK_LAYER_COLOR

config ZMK_LAYER_COLOR_DEBOUNCE_MS
    int "Wait this long (ms) after a layer change before changing colour"
    default 15

config ZMK_LAYER_COLOR_RESYNC_DELAY_MS
    int "Wait this long (ms) after the halves connect before re-sending the colour"
    default 3000

endif
```

## boards/shields/nice_view_babylon/Kconfig.defconfig
```kconfig
# Copyright (c) 2023 The ZMK Contributors
# SPDX-License-Identifier: MIT
#
# nice!view with a picture screen: battery + connection status at the top,
# Etemenanki ziggurat (left half) / Hanging Gardens of Babylon (right half) below.

if SHIELD_NICE_VIEW_BABYLON

config LV_Z_VDB_SIZE
    default 100

config LV_DPI_DEF
    default 161

config LV_Z_BITS_PER_PIXEL
    default 1

choice LV_COLOR_DEPTH
    default LV_COLOR_DEPTH_1
endchoice

choice ZMK_DISPLAY_WORK_QUEUE
    default ZMK_DISPLAY_WORK_QUEUE_DEDICATED
endchoice

choice ZMK_DISPLAY_STATUS_SCREEN
    default ZMK_DISPLAY_STATUS_SCREEN_CUSTOM
endchoice

config LV_Z_MEM_POOL_SIZE
    default 4096 if ZMK_DISPLAY_STATUS_SCREEN_CUSTOM

config ZMK_DISPLAY_STATUS_SCREEN_CUSTOM
    imply NICE_VIEW_BABYLON_STATUS

config NICE_VIEW_BABYLON_STATUS
    bool "nice!view picture status screen"
    select LV_FONT_MONTSERRAT_16
    select LV_USE_IMG
    select LV_USE_CANVAS

config NICE_VIEW_BABYLON_INVERTED
    bool "Invert the screen colours (white on black)"

config ZMK_DISPLAY_STATUS_SCREEN_BUILT_IN
    select LV_FONT_MONTSERRAT_26

endif # SHIELD_NICE_VIEW_BABYLON
```

## dts/bindings/zmk,behavior-pc-scene.yaml
```yaml
description: |
  Shares the active Bluetooth profile with both halves of a split keyboard
  (used by the nice!view screens: night picture on PC one, day on PC two).
  Invoked automatically by the left half; not meant to be put on a key.
  Keep the node name to 8 characters or fewer.

compatible: "zmk,behavior-pc-scene"

include: one_param.yaml
```

## dts/bindings/zmk,layer-color.yaml
```yaml
description: |
  Colours the RGB underglow by the highest active keymap layer.
  Add one child node per layer you want coloured. Layers without a child
  use the colour of the next lower active layer.

compatible: "zmk,layer-color"

child-binding:
  description: Colour for one layer

  properties:
    layer:
      type: int
      required: true
      description: Layer number, counting from 0 in keymap order.

    hue:
      type: array
      required: true
      description: |
        0-360. 0 red, 30 orange, 60 yellow, 120 green, 180 cyan, 240 blue, 300 magenta.
        One value per Bluetooth profile: <PC-one PC-two ...>. A single value
        is used on every profile; profiles past the end of the list use the first.

    saturation:
      type: int
      default: 100
      description: 0-100. Lower values look paler, 0 is white.

    brightness:
      type: int
      description: 0-100. Leave out to keep the brightness you set with the RGB keys.

    effect:
      type: int
      default: 0
      description: 0 solid, 1 breathe, 2 spectrum, 3 swirl (rainbow by column).
```
